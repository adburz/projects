//////////////////////////////////////////////////////////////////////////////
// Laboratory AVR Microcontrollers Part2
// Program template for C lab 7
// Please fill in this information before starting coding
// Authors:
// 1. Adam Burzynski
// Group: 2
// Section: 1
// Task number: 11
//
// Version: 2020v3.0
//////////////////////////////////////////////////////////////////////////////

#include <avr/io.h>
#include <avr/interrupt.h>
// please look into header pgmspace.h functions to properly read from ROM
#include <avr/pgmspace.h>
// please change this to proper value given by the teacher
#define F_CPU 16000000L
#define nLength 100
uint8_t TAB_RAM[nLength];
//-----------this is table with data example --------------------------------------
// please correct end of this table according to the guidelines given by the teacher
uint8_t const TAB_ROM[] PROGMEM = {
0x00, 0x01, 0x02, 0x03, 0x04, 0x05, 0x06, 0x07, 0x08, 0x09, 0x0A, 0x0B, 0x0C, 0x0D, 0x0E, 0x1F,
0x10, 0x11, 0x12, 0x13, 0x14, 0x15, 0x16, 0x17, 0x18, 0x19, 0x1A, 0x1B, 0x1C, 0x1D, 0x1F, 0x1F,
0x20, 0x21, 0x22, 0x23, 0x24, 0x25, 0x26, 0x27, 0x28, 0x29, 0x2A, 0x2B, 0x2C, 0x2D, 0x2E, 0x2F,
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0x00, 0x00};
//-----this empty table example-----uncomment to test---------------
// uint8_t const TAB_ROM[] PROGMEM = { 0x00, 0x00};
// please correct end of this table according to the guidelines given by the teacher
//uint8_t const TAB_ROM[] PROGMEM = { 0xFF, 0xFF};
// global variable to count the number of overflows
volatile uint8_t tot_overflow;

//Task:
//Write a program that copies data from TAB_ROM to TAB_RAM. Copying should
//start after any button is pressed. The LED connected to Port B.6 should light
//(state ON) during copying, and then turn it exactly 250ms OFF, 250ms ON and
//OFF.


// initialize timer, interrupt and variable
void timer1_init()
{
	TIMSK1 = 1 << TOIE1;	// enable timer overflow interrupt for both Timer1
	TCCR1B |= (1 << CS10) | (1 << CS11); // setting prescaler to 64
	TCNT1 = 3035;	// initializing timer with value FFFF - 62500 = 3035

	// initialize overflow counter variable
	tot_overflow = 0;
}

// TIMER0 overflow interrupt service routine
// called whenever TCNT0 overflows
ISR(TIMER1_OVF_vect)
{
	tot_overflow++;	// incrementing interrupts counter
	TCNT1 = 3035;	// initializing timer with value FFFF - 62500 = 3035
}

int main (void)
{

	//---------------------------------------------------------------------
	// Main program code place here
	// 1. Place here code related to initialization of ports and interrupts

	//Initializing all ports
	//buttons on portA as input with pullup
	DDRA=0x00;
	PORTA=0xFF;	//pull ups
	
	//initializing LEDs on portB.5 .6 .7 and setting them OFF
	 DDRB = DDRB|0xE0;
	 PORTB = PORTB|0xE0;

	 //initializing portC
	 DDRC=0xFF; 
	 PORTC=0xFF;

	 //initializing portL
	 DDRL=0xFF;
	 PORTL=0x00;

	 // 2. Enable interrupts if needed
	 

	// 3. Place here main code

	//checks if any button is pressed
	if(PINA != 0xFF) 
	{
		//start copying
		PORTB= PORTB&0xBF; //turns on the b.6 led ( 0xBF = 1011 1111 )
		for(int i=0; i<nLength; i++)	//copying ROM->RAM loop
		{
			//checking if end of TAB_ROM array
			if(pgm_read_byte_far(TAB_ROM + i) == 0 && pgm_read_byte_far(TAB_ROM + i + 1) == 0) break; 
			//copying ROM to RAM
			TAB_RAM[i]= pgm_read_byte_far(pgm_get_far_address(TAB_ROM)+i);
		}		
		
	}
	sei();
	timer1_init();
	while(1)
	{
		if(tot_overflow == 1){
			PORTB= PORTB|0x40;//turns off the b.6 led ( 0x40 = 0100 0000) after 250ms
			tot_overflow++;
			}
		else if(tot_overflow == 3) // added tot_overflow == 3 to prevent going into first if each iteration
		{
			PORTB= PORTB&0xBF; //turns on the b.6 led ( 0xBF = 1011 1111 ) after next 250ms
			PORTB= PORTB|0x40;//turns off the b.6 led ( 0x40 = 0100 0000) immediately after turning it on
			break;
		}
	}
	cli(); // disable global interrupt flag

	// Program end
	//----------------------------------------------------------------------
}
// -------------------------------------------------------------------